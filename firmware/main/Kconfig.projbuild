## firmware/main/Kconfig.projbuild
```kconfig
menu "Unofficial Coinbase AMOLED terminal"

choice TERMINAL_BOARD_REVISION
    prompt "Waveshare ESP32-S3 Touch AMOLED 1.8 revision"
    default TERMINAL_BOARD_V2
    help
        Select the controller set fitted to the board. Flashing the wrong
        variant can leave the display blank until the correct image is flashed.

    config TERMINAL_BOARD_V1
        bool "V1: SH8601 + FT5x06/FT3168 + AXP2101"

    config TERMINAL_BOARD_V2
        bool "V2: CO5300 + CST820"
endchoice

endmenu
```

## firmware/sdkconfig.defaults
```kconfig
CONFIG_IDF_TARGET="esp32s3"
CONFIG_ESPTOOLPY_FLASHSIZE_16MB=y
CONFIG_SPIRAM=y
CONFIG_SPIRAM_MODE_OCT=y
CONFIG_SPIRAM_SPEED_80M=y
CONFIG_SPIRAM_USE_MALLOC=y
CONFIG_ESP_DEFAULT_CPU_FREQ_MHZ_240=y
CONFIG_PARTITION_TABLE_CUSTOM=y
CONFIG_PARTITION_TABLE_CUSTOM_FILENAME="partitions.csv"
CONFIG_BOOTLOADER_APP_ROLLBACK_ENABLE=y
CONFIG_COMPILER_OPTIMIZATION_SIZE=y
CONFIG_MBEDTLS_CERTIFICATE_BUNDLE=y
CONFIG_ESP_HTTP_CLIENT_ENABLE_HTTPS=y
```
